&arduino_i2c {
    trustx@30 {
        status = "okay";
        compatible = "infineon,optiga-trust-m";
        reg = <0x30>;
        label = "trust-m";
		/* Power control pin (D4) for Infineon MYIOT adapter board Slot 1*/
		power-gpios = <&arduino_header 10 GPIO_ACTIVE_HIGH>;
    };
};
