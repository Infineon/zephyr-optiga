## CMakeLists.txt
```
# SPDX-License-Identifier: Apache-2.0

cmake_minimum_required(VERSION 3.13.1)
find_package(Zephyr HINTS $ENV{ZEPHYR_BASE})
project(optiga_tests)

FILE(GLOB app_sources src/*.c)
target_sources(app PRIVATE ${app_sources})
```

## prj.conf
```kconfig
CONFIG_ZTEST=y

CONFIG_LOG=y

CONFIG_I2C=y
#CONFIG_STDOUT_CONSOLE=y
CONFIG_DEBUG=y
#CONFIG_UART_CONSOLE=n
#CONFIG_RTT_CONSOLE=y
CONFIG_USE_SEGGER_RTT=n
CONFIG_CRYPTO=y
CONFIG_OPTIGA=y
CONFIG_CRYPTO_LOG_LEVEL_WRN=y
CONFIG_MAIN_STACK_SIZE=4096
CONFIG_LOG_BUFFER_SIZE=2048
CONFIG_ASSERT=y
CONFIG_POLL=y
CONFIG_STACK_CANARIES=y
CONFIG_ENTROPY_GENERATOR=y
CONFIG_HW_STACK_PROTECTION=y
CONFIG_I2C_LOG_LEVEL_OFF=y

# needed for mbedTLS
CONFIG_MINIMAL_LIBC_MALLOC_ARENA_SIZE=1024

# needed for shielded connection
CONFIG_MBEDTLS=y
CONFIG_MBEDTLS_CIPHER_CCM_ENABLED=y

# We allocate some test data on the stack
CONFIG_ZTEST_STACKSIZE=8192
```

## src/main.c
```c
/*
 * Copyright (c) 2020 Infineon Technologies AG
 *
 * SPDX-License-Identifier: Apache-2.0
 */

#include <ztest.h>
#include <zephyr.h>

extern void test_optiga_apdu_main(void);
extern void test_optiga_trust_m_main(void);

void test_main(void)
{
	test_optiga_apdu_main();
	test_optiga_trust_m_main();
}
```

## src/test_data_common.c
```c
/*
 * Copyright (c) 2020 Infineon Technologies AG
 *
 * SPDX-License-Identifier: Apache-2.0
 */

#include <stdint.h>
#include <stddef.h>

#define ARR_SIZE(x) (sizeof(x)/sizeof(x[0]))


// Signature signing key
const uint8_t sign_key[] = {
    0x21, 0xFB, 0x35, 0x5D, 0x5B, 0xAB, 0xB0, 0x45, 0xEB, 0x34, 0xF6, 0x66, 0xF6, 0xA9, 0x3D, 0xD2,
    0x75, 0x14, 0xE0, 0xA1, 0x27, 0xD9, 0xD0, 0x1A, 0x79, 0x4C, 0xC8, 0x1A, 0xE6, 0x47, 0x86, 0x1A
};

const size_t sign_key_len = ARR_SIZE(sign_key);

// Signature verification key
const uint8_t verify_test_key[] = {
    0xD0, 0x17, 0x5E, 0xF0, 0xE0, 0x04, 0x7F, 0xC7, 0x57, 0xE3, 0x38, 0x82, 0xEA, 0x90, 0xDB, 0xFC,
    0xD4, 0x73, 0x7D, 0x7C, 0xC4, 0xE7, 0x48, 0x95, 0xC7, 0x18, 0xC2, 0xD1, 0x7D, 0x84, 0x33, 0x33,
    0x50, 0x27, 0x70, 0xCC, 0xA7, 0x56, 0x75, 0x88, 0x6E, 0xF4, 0x3C, 0x7A, 0x13, 0x93, 0xAB, 0x58,
    0xB8, 0x54, 0xD5, 0x02, 0xD9, 0xB0, 0x6D, 0xF2, 0x2A, 0x24, 0x1D, 0xEF, 0xC9, 0x10, 0x5A, 0xFB
};

const size_t verify_test_key_len = ARR_SIZE(verify_test_key);

// Signature verification key for OPTIGA, encoded as ASN.1 DER BITSTRING
const uint8_t verify_test_key_optiga[] = {
    0x03, // ASN.1 BITSTRING
    0x42, // bytes following
    0x00, // no unused bits
    0x04, // uncompressed key, see https://tools.ietf.org/html/rfc5480#section-2.2
    // verify_test_key bytes
    0xD0, 0x17, 0x5E, 0xF0, 0xE0, 0x04, 0x7F, 0xC7, 0x57, 0xE3, 0x38, 0x82, 0xEA, 0x90, 0xDB, 0xFC,
    0xD4, 0x73, 0x7D, 0x7C, 0xC4, 0xE7, 0x48, 0x95, 0xC7, 0x18, 0xC2, 0xD1, 0x7D, 0x84, 0x33, 0x33,
    0x50, 0x27, 0x70, 0xCC, 0xA7, 0x56, 0x75, 0x88, 0x6E, 0xF4, 0x3C, 0x7A, 0x13, 0x93, 0xAB, 0x58,
    0xB8, 0x54, 0xD5, 0x02, 0xD9, 0xB0, 0x6D, 0xF2, 0x2A, 0x24, 0x1D, 0xEF, 0xC9, 0x10, 0x5A, 0xFB
};

const size_t verify_test_key_optiga_len = ARR_SIZE(verify_test_key_optiga);

const uint8_t test_hash[] = {
    0x7F, 0x83, 0xB1, 0x65, 0x7F, 0xF1, 0xFC, 0x53, 0xB9, 0x2D, 0xC1, 0x81, 0x48, 0xA1, 0xD6, 0x5D,
    0xFC, 0x2D, 0x4B, 0x1F, 0xA3, 0xD6, 0x77, 0x28, 0x4A, 0xDD, 0xD2, 0x00, 0x12, 0x6D, 0x90, 0x69
};
const size_t test_hash_len = ARR_SIZE(test_hash);

const uint8_t test_signature[] = {
    // R bytes
    0x8C, 0x73, 0x3C, 0xA6, 0xE9, 0x5F, 0xD5, 0xF9, 0x59, 0x2E, 0x75, 0xC6, 0x3D, 0x05, 0x88, 0x55,
    0x89, 0x9B, 0x31, 0x64, 0x96, 0x9F, 0x20, 0x63, 0xF5, 0x55, 0xA6, 0x40, 0x1D, 0x5E, 0xCA, 0x06,
    // S bytes
    0x33, 0x92, 0x29, 0x31, 0xB3, 0x48, 0xAC, 0x57, 0x25, 0x60, 0xA3, 0x49, 0xB4, 0xC8, 0xCF, 0xCA,
    0xC6, 0x89, 0x3E, 0x2B, 0xD1, 0xE8, 0x38, 0x36, 0x55, 0x3C, 0x17, 0xC3, 0xA2, 0xEB, 0x6C, 0x2F
};

const size_t test_signature_len = ARR_SIZE(test_signature);

// ASN.1 DER encoded signature with signing key = sign_key and digest = test_hash
const uint8_t test_signature_der[] = {
    0x02, // ASN.1 INTEGER
    0x21, // number of bytes following
    0x00, // stuffing byte, because highes bit is set in following byte
    // signature R value
    0x8C, 0x73, 0x3C, 0xA6, 0xE9, 0x5F, 0xD5, 0xF9, 0x59, 0x2E, 0x75, 0xC6, 0x3D, 0x05, 0x88, 0x55,
    0x89, 0x9B, 0x31, 0x64, 0x96, 0x9F, 0x20, 0x63, 0xF5, 0x55, 0xA6, 0x40, 0x1D, 0x5E, 0xCA, 0x06,
    0x02, // ASN.1 INTEGER
    0x20, // number of bytes following, no stuffing byte, because highest bit not set
    // signature S value
    0x33, 0x92, 0x29, 0x31, 0xB3, 0x48, 0xAC, 0x57, 0x25, 0x60, 0xA3, 0x49, 0xB4, 0xC8, 0xCF, 0xCA,
    0xC6, 0x89, 0x3E, 0x2B, 0xD1, 0xE8, 0x38, 0x36, 0x55, 0x3C, 0x17, 0xC3, 0xA2, 0xEB, 0x6C, 0x2F
};

const size_t test_signature_der_len = ARR_SIZE(test_signature_der);

// certificate with the public key to sign_key2 to verify the signature on the SUIT Manifest
const uint8_t test_certificate[] = {
    0x30, 0x82, 0x01, 0xDD, 0x30, 0x82, 0x01, 0x84, 0xA0, 0x03, 0x02, 0x01, 0x02, 0x02, 0x09, 0x00,
    0xFF, 0xC6, 0x32, 0x4D, 0x68, 0x7F, 0x17, 0x6D, 0x30, 0x0A, 0x06, 0x08, 0x2A, 0x86, 0x48, 0xCE,
    0x3D, 0x04, 0x03, 0x02, 0x30, 0x45, 0x31, 0x0B, 0x30, 0x09, 0x06, 0x03, 0x55, 0x04, 0x06, 0x13,
    0x02, 0x41, 0x55, 0x31, 0x13, 0x30, 0x11, 0x06, 0x03, 0x55, 0x04, 0x08, 0x0C, 0x0A, 0x53, 0x6F,
    0x6D, 0x65, 0x2D, 0x53, 0x74, 0x61, 0x74, 0x65, 0x31, 0x21, 0x30, 0x1F, 0x06, 0x03, 0x55, 0x04,
    0x0A, 0x0C, 0x18, 0x49, 0x6E, 0x74, 0x65, 0x72, 0x6E, 0x65, 0x74, 0x20, 0x57, 0x69, 0x64, 0x67,
    0x69, 0x74, 0x73, 0x20, 0x50, 0x74, 0x79, 0x20, 0x4C, 0x74, 0x64, 0x30, 0x1E, 0x17, 0x0D, 0x31,
    0x38, 0x30, 0x35, 0x32, 0x38, 0x30, 0x39, 0x35, 0x39, 0x30, 0x34, 0x5A, 0x17, 0x0D, 0x32, 0x30,
    0x30, 0x35, 0x32, 0x37, 0x30, 0x39, 0x35, 0x39, 0x30, 0x34, 0x5A, 0x30, 0x45, 0x31, 0x0B, 0x30,
    0x09, 0x06, 0x03, 0x55, 0x04, 0x06, 0x13, 0x02, 0x41, 0x55, 0x31, 0x13, 0x30, 0x11, 0x06, 0x03,
    0x55, 0x04, 0x08, 0x0C, 0x0A, 0x53, 0x6F, 0x6D, 0x65, 0x2D, 0x53, 0x74, 0x61, 0x74, 0x65, 0x31,
    0x21, 0x30, 0x1F, 0x06, 0x03, 0x55, 0x04, 0x0A, 0x0C, 0x18, 0x49, 0x6E, 0x74, 0x65, 0x72, 0x6E,
    0x65, 0x74, 0x20, 0x57, 0x69, 0x64, 0x67, 0x69, 0x74, 0x73, 0x20, 0x50, 0x74, 0x79, 0x20, 0x4C,
    0x74, 0x64, 0x30, 0x59, 0x30, 0x13, 0x06, 0x07, 0x2A, 0x86, 0x48, 0xCE, 0x3D, 0x02, 0x01, 0x06,
    0x08, 0x2A, 0x86, 0x48, 0xCE, 0x3D, 0x03, 0x01, 0x07, 0x03, 0x42, 0x00, 0x04, 0xD0, 0x17, 0x5E,
    0xF0, 0xE0, 0x04, 0x7F, 0xC7, 0x57, 0xE3, 0x38, 0x82, 0xEA, 0x90, 0xDB, 0xFC, 0xD4, 0x73, 0x7D,
    0x7C, 0xC4, 0xE7, 0x48, 0x95, 0xC7, 0x18, 0xC2, 0xD1, 0x7D, 0x84, 0x33, 0x33, 0x50, 0x27, 0x70,
    0xCC, 0xA7, 0x56, 0x75, 0x88, 0x6E, 0xF4, 0x3C, 0x7A, 0x13, 0x93, 0xAB, 0x58, 0xB8, 0x54, 0xD5,
    0x02, 0xD9, 0xB0, 0x6D, 0xF2, 0x2A, 0x24, 0x1D, 0xEF, 0xC9, 0x10, 0x5A, 0xFB, 0xA3, 0x5D, 0x30,
    0x5B, 0x30, 0x1D, 0x06, 0x03, 0x55, 0x1D, 0x0E, 0x04, 0x16, 0x04, 0x14, 0xDC, 0x54, 0xFF, 0x50,
    0x06, 0x09, 0x62, 0xEB, 0xCA, 0x11, 0xC0, 0x69, 0xFF, 0xF4, 0x5C, 0x8C, 0xDE, 0xD2, 0xF3, 0x16,
    0x30, 0x1F, 0x06, 0x03, 0x55, 0x1D, 0x23, 0x04, 0x18, 0x30, 0x16, 0x80, 0x14, 0xDC, 0x54, 0xFF,
    0x50, 0x06, 0x09, 0x62, 0xEB, 0xCA, 0x11, 0xC0, 0x69, 0xFF, 0xF4, 0x5C, 0x8C, 0xDE, 0xD2, 0xF3,
    0x16, 0x30, 0x0C, 0x06, 0x03, 0x55, 0x1D, 0x13, 0x01, 0x01, 0xFF, 0x04, 0x02, 0x30, 0x00, 0x30,
    0x0B, 0x06, 0x03, 0x55, 0x1D, 0x0F, 0x04, 0x04, 0x03, 0x02, 0x02, 0x84, 0x30, 0x0A, 0x06, 0x08,
    0x2A, 0x86, 0x48, 0xCE, 0x3D, 0x04, 0x03, 0x02, 0x03, 0x47, 0x00, 0x30, 0x44, 0x02, 0x20, 0x07,
    0x7B, 0x50, 0x63, 0x06, 0x6C, 0x95, 0xD6, 0x8B, 0xA1, 0xD9, 0xE7, 0x65, 0xB7, 0x83, 0x0E, 0x98,
    0x1F, 0x36, 0xEB, 0xF2, 0x93, 0xA2, 0x65, 0x81, 0x36, 0x2F, 0x74, 0xDF, 0x24, 0x71, 0x06, 0x02,
    0x20, 0x6B, 0x41, 0x04, 0x87, 0xA1, 0x91, 0xE4, 0x4A, 0x9F, 0x0B, 0x67, 0x9C, 0x2E, 0xC0, 0xCB,
    0xF0, 0x29, 0xBB, 0xED, 0x31, 0x68, 0x85, 0x35, 0x9E, 0x64, 0xB0, 0xE9, 0xBA, 0xF0, 0xCC, 0x2E,
    0xE9
};

const uint8_t test_signature_hash[] = {
    0x7F, 0x83, 0xB1, 0x65, 0x7F, 0xF1, 0xFC, 0x53, 0xB9, 0x2D, 0xC1, 0x81, 0x48, 0xA1, 0xD6, 0x5D,
    0xFC, 0x2D, 0x4B, 0x1F, 0xA3, 0xD6, 0x77, 0x28, 0x4A, 0xDD, 0xD2, 0x00, 0x12, 0x6D, 0x90, 0x69
};

const size_t test_signature_hash_len = ARR_SIZE(test_signature_hash);

// 100 bytes data to fill a small arbitrary data object
const uint8_t test_small_data_obj[] = {
    0x01, 0x02, 0x03, 0x04, 0x05, 0x06, 0x07, 0x08, 0x09, 0x0A,
    0x01, 0x02, 0x03, 0x04, 0x05, 0x06, 0x07, 0x08, 0x09, 0x0A,
    0x01, 0x02, 0x03, 0x04, 0x05, 0x06, 0x07, 0x08, 0x09, 0x0A,
    0x01, 0x02, 0x03, 0x04, 0x05, 0x06, 0x07, 0x08, 0x09, 0x0A,
    0x01, 0x02, 0x03, 0x04, 0x05, 0x06, 0x07, 0x08, 0x09, 0x0A,
    0x01, 0x02, 0x03, 0x04, 0x05, 0x06, 0x07, 0x08, 0x09, 0x0A,
    0x01, 0x02, 0x03, 0x04, 0x05, 0x06, 0x07, 0x08, 0x09, 0x0A,
    0x01, 0x02, 0x03, 0x04, 0x05, 0x06, 0x07, 0x08, 0x09, 0x0A,
    0x01, 0x02, 0x03, 0x04, 0x05, 0x06, 0x07, 0x08, 0x09, 0x0A,
    0x01, 0x02, 0x03, 0x04, 0x05, 0x06, 0x07, 0x08, 0x09, 0x0A
};

const size_t test_small_data_obj_len = ARR_SIZE(test_small_data_obj);

// 1500 bytes data to fill a small arbitrary data object
const uint8_t test_large_data_obj[] = {
    0x01, 0x02, 0x03, 0x04, 0x05, 0x06, 0x07, 0x08, 0x09, 0x0A, 0x01, 0x02, 0x03, 0x04, 0x05, 0x06, 0x07, 0x08, 0x09, 0x0A,
    0x01, 0x02, 0x03, 0x04, 0x05, 0x06, 0x07, 0x08, 0x09, 0x0A, 0x01, 0x02, 0x03, 0x04, 0x05, 0x06, 0x07, 0x08, 0x09, 0x0A,
    0x01, 0x02, 0x03, 0x04, 0x05, 0x06, 0x07, 0x08, 0x09, 0x0A, 0x01, 0x02, 0x03, 0x04, 0x05, 0x06, 0x07, 0x08, 0x09, 0x0A,
    0x01, 0x02, 0x03, 0x04, 0x05, 0x06, 0x07, 0x08, 0x09, 0x0A, 0x01, 0x02, 0x03, 0x04, 0x05, 0x06, 0x07, 0x08, 0x09, 0x0A,
    0x01, 0x02, 0x03, 0x04, 0x05, 0x06, 0x07, 0x08, 0x09, 0x0A, 0x01, 0x02, 0x03, 0x04, 0x05, 0x06, 0x07, 0x08, 0x09, 0x0A,
    0x01, 0x02, 0x03, 0x04, 0x05, 0x06, 0x07, 0x08, 0x09, 0x0A, 0x01, 0x02, 0x03, 0x04, 0x05, 0x06, 0x07, 0x08, 0x09, 0x0A,
    0x01, 0x02, 0x03, 0x04, 0x05, 0x06, 0x07, 0x08, 0x09, 0x0A, 0x01, 0x02, 0x03, 0x04, 0x05, 0x06, 0x07, 0x08, 0x09, 0x0A,
    0x01, 0x02, 0x03, 0x04, 0x05, 0x06, 0x07, 0x08, 0x09, 0x0A, 0x01, 0x02, 0x03, 0x04, 0x05, 0x06, 0x07, 0x08, 0x09, 0x0A,
    0x01, 0x02, 0x03, 0x04, 0x05, 0x06, 0x07, 0x08, 0x09, 0x0A, 0x01, 0x02, 0x03, 0x04, 0x05, 0x06, 0x07, 0x08, 0x09, 0x0A,
    0x01, 0x02, 0x03, 0x04, 0x05, 0x06, 0x07, 0x08, 0x09, 0x0A, 0x01, 0x02, 0x03, 0x04, 0x05, 0x06, 0x07, 0x08, 0x09, 0x0A,
    0x01, 0x02, 0x03, 0x04, 0x05, 0x06, 0x07, 0x08, 0x09, 0x0A, 0x01, 0x02, 0x03, 0x04, 0x05, 0x06, 0x07, 0x08, 0x09, 0x0A,
    0x01, 0x02, 0x03, 0x04, 0x05, 0x06, 0x07, 0x08, 0x09, 0x0A, 0x01, 0x02, 0x03, 0x04, 0x05, 0x06, 0x07, 0x08, 0x09, 0x0A,
    0x01, 0x02, 0x03, 0x04, 0x05, 0x06, 0x07, 0x08, 0x09, 0x0A, 0x01, 0x02, 0x03, 0x04, 0x05, 0x06, 0x07, 0x08, 0x09, 0x0A,
    0x01, 0x02, 0x03, 0x04, 0x05, 0x06, 0x07, 0x08, 0x09, 0x0A, 0x01, 0x02, 0x03, 0x04, 0x05, 0x06, 0x07, 0x08, 0x09, 0x0A,
    0x01, 0x02, 0x03, 0x04, 0x05, 0x06, 0x07, 0x08, 0x09, 0x0A, 0x01, 0x02, 0x03, 0x04, 0x05, 0x06, 0x07, 0x08, 0x09, 0x0A,
    0x01, 0x02, 0x03, 0x04, 0x05, 0x06, 0x07, 0x08, 0x09, 0x0A, 0x01, 0x02, 0x03, 0x04, 0x05, 0x06, 0x07, 0x08, 0x09, 0x0A,
    0x01, 0x02, 0x03, 0x04, 0x05, 0x06, 0x07, 0x08, 0x09, 0x0A, 0x01, 0x02, 0x03, 0x04, 0x05, 0x06, 0x07, 0x08, 0x09, 0x0A,
    0x01, 0x02, 0x03, 0x04, 0x05, 0x06, 0x07, 0x08, 0x09, 0x0A, 0x01, 0x02, 0x03, 0x04, 0x05, 0x06, 0x07, 0x08, 0x09, 0x0A,
    0x01, 0x02, 0x03, 0x04, 0x05, 0x06, 0x07, 0x08, 0x09, 0x0A, 0x01, 0x02, 0x03, 0x04, 0x05, 0x06, 0x07, 0x08, 0x09, 0x0A,
    0x01, 0x02, 0x03, 0x04, 0x05, 0x06, 0x07, 0x08, 0x09, 0x0A, 0x01, 0x02, 0x03, 0x04, 0x05, 0x06, 0x07, 0x08, 0x09, 0x0A,
    0x01, 0x02, 0x03, 0x04, 0x05, 0x06, 0x07, 0x08, 0x09, 0x0A, 0x01, 0x02, 0x03, 0x04, 0x05, 0x06, 0x07, 0x08, 0x09, 0x0A,
    0x01, 0x02, 0x03, 0x04, 0x05, 0x06, 0x07, 0x08, 0x09, 0x0A, 0x01, 0x02, 0x03, 0x04, 0x05, 0x06, 0x07, 0x08, 0x09, 0x0A,
    0x01, 0x02, 0x03, 0x04, 0x05, 0x06, 0x07, 0x08, 0x09, 0x0A, 0x01, 0x02, 0x03, 0x04, 0x05, 0x06, 0x07, 0x08, 0x09, 0x0A,
    0x01, 0x02, 0x03, 0x04, 0x05, 0x06, 0x07, 0x08, 0x09, 0x0A, 0x01, 0x02, 0x03, 0x04, 0x05, 0x06, 0x07, 0x08, 0x09, 0x0A,
    0x01, 0x02, 0x03, 0x04, 0x05, 0x06, 0x07, 0x08, 0x09, 0x0A, 0x01, 0x02, 0x03, 0x04, 0x05, 0x06, 0x07, 0x08, 0x09, 0x0A,
    0x01, 0x02, 0x03, 0x04, 0x05, 0x06, 0x07, 0x08, 0x09, 0x0A, 0x01, 0x02, 0x03, 0x04, 0x05, 0x06, 0x07, 0x08, 0x09, 0x0A,
    0x01, 0x02, 0x03, 0x04, 0x05, 0x06, 0x07, 0x08, 0x09, 0x0A, 0x01, 0x02, 0x03, 0x04, 0x05, 0x06, 0x07, 0x08, 0x09, 0x0A,
    0x01, 0x02, 0x03, 0x04, 0x05, 0x06, 0x07, 0x08, 0x09, 0x0A, 0x01, 0x02, 0x03, 0x04, 0x05, 0x06, 0x07, 0x08, 0x09, 0x0A,
    0x01, 0x02, 0x03, 0x04, 0x05, 0x06, 0x07, 0x08, 0x09, 0x0A, 0x01, 0x02, 0x03, 0x04, 0x05, 0x06, 0x07, 0x08, 0x09, 0x0A,
    0x01, 0x02, 0x03, 0x04, 0x05, 0x06, 0x07, 0x08, 0x09, 0x0A, 0x01, 0x02, 0x03, 0x04, 0x05, 0x06, 0x07, 0x08, 0x09, 0x0A,
    0x01, 0x02, 0x03, 0x04, 0x05, 0x06, 0x07, 0x08, 0x09, 0x0A, 0x01, 0x02, 0x03, 0x04, 0x05, 0x06, 0x07, 0x08, 0x09, 0x0A,
    0x01, 0x02, 0x03, 0x04, 0x05, 0x06, 0x07, 0x08, 0x09, 0x0A, 0x01, 0x02, 0x03, 0x04, 0x05, 0x06, 0x07, 0x08, 0x09, 0x0A,
    0x01, 0x02, 0x03, 0x04, 0x05, 0x06, 0x07, 0x08, 0x09, 0x0A, 0x01, 0x02, 0x03, 0x04, 0x05, 0x06, 0x07, 0x08, 0x09, 0x0A,
    0x01, 0x02, 0x03, 0x04, 0x05, 0x06, 0x07, 0x08, 0x09, 0x0A, 0x01, 0x02, 0x03, 0x04, 0x05, 0x06, 0x07, 0x08, 0x09, 0x0A,
    0x01, 0x02, 0x03, 0x04, 0x05, 0x06, 0x07, 0x08, 0x09, 0x0A, 0x01, 0x02, 0x03, 0x04, 0x05, 0x06, 0x07, 0x08, 0x09, 0x0A,
    0x01, 0x02, 0x03, 0x04, 0x05, 0x06, 0x07, 0x08, 0x09, 0x0A, 0x01, 0x02, 0x03, 0x04, 0x05, 0x06, 0x07, 0x08, 0x09, 0x0A,
    0x01, 0x02, 0x03, 0x04, 0x05, 0x06, 0x07, 0x08, 0x09, 0x0A, 0x01, 0x02, 0x03, 0x04, 0x05, 0x06, 0x07, 0x08, 0x09, 0x0A,
    0x01, 0x02, 0x03, 0x04, 0x05, 0x06, 0x07, 0x08, 0x09, 0x0A, 0x01, 0x02, 0x03, 0x04, 0x05, 0x06, 0x07, 0x08, 0x09, 0x0A,
    0x01, 0x02, 0x03, 0x04, 0x05, 0x06, 0x07, 0x08, 0x09, 0x0A, 0x01, 0x02, 0x03, 0x04, 0x05, 0x06, 0x07, 0x08, 0x09, 0x0A,
    0x01, 0x02, 0x03, 0x04, 0x05, 0x06, 0x07, 0x08, 0x09, 0x0A, 0x01, 0x02, 0x03, 0x04, 0x05, 0x06, 0x07, 0x08, 0x09, 0x0A,
    0x01, 0x02, 0x03, 0x04, 0x05, 0x06, 0x07, 0x08, 0x09, 0x0A, 0x01, 0x02, 0x03, 0x04, 0x05, 0x06, 0x07, 0x08, 0x09, 0x0A,
    0x01, 0x02, 0x03, 0x04, 0x05, 0x06, 0x07, 0x08, 0x09, 0x0A, 0x01, 0x02, 0x03, 0x04, 0x05, 0x06, 0x07, 0x08, 0x09, 0x0A,
    0x01, 0x02, 0x03, 0x04, 0x05, 0x06, 0x07, 0x08, 0x09, 0x0A, 0x01, 0x02, 0x03, 0x04, 0x05, 0x06, 0x07, 0x08, 0x09, 0x0A,
    0x01, 0x02, 0x03, 0x04, 0x05, 0x06, 0x07, 0x08, 0x09, 0x0A, 0x01, 0x02, 0x03, 0x04, 0x05, 0x06, 0x07, 0x08, 0x09, 0x0A,
    0x01, 0x02, 0x03, 0x04, 0x05, 0x06, 0x07, 0x08, 0x09, 0x0A, 0x01, 0x02, 0x03, 0x04, 0x05, 0x06, 0x07, 0x08, 0x09, 0x0A,
    0x01, 0x02, 0x03, 0x04, 0x05, 0x06, 0x07, 0x08, 0x09, 0x0A, 0x01, 0x02, 0x03, 0x04, 0x05, 0x06, 0x07, 0x08, 0x09, 0x0A,
    0x01, 0x02, 0x03, 0x04, 0x05, 0x06, 0x07, 0x08, 0x09, 0x0A, 0x01, 0x02, 0x03, 0x04, 0x05, 0x06, 0x07, 0x08, 0x09, 0x0A,
    0x01, 0x02, 0x03, 0x04, 0x05, 0x06, 0x07, 0x08, 0x09, 0x0A, 0x01, 0x02, 0x03, 0x04, 0x05, 0x06, 0x07, 0x08, 0x09, 0x0A,
    0x01, 0x02, 0x03, 0x04, 0x05, 0x06, 0x07, 0x08, 0x09, 0x0A, 0x01, 0x02, 0x03, 0x04, 0x05, 0x06, 0x07, 0x08, 0x09, 0x0A,
    0x01, 0x02, 0x03, 0x04, 0x05, 0x06, 0x07, 0x08, 0x09, 0x0A, 0x01, 0x02, 0x03, 0x04, 0x05, 0x06, 0x07, 0x08, 0x09, 0x0A,
    0x01, 0x02, 0x03, 0x04, 0x05, 0x06, 0x07, 0x08, 0x09, 0x0A, 0x01, 0x02, 0x03, 0x04, 0x05, 0x06, 0x07, 0x08, 0x09, 0x0A,
    0x01, 0x02, 0x03, 0x04, 0x05, 0x06, 0x07, 0x08, 0x09, 0x0A, 0x01, 0x02, 0x03, 0x04, 0x05, 0x06, 0x07, 0x08, 0x09, 0x0A,
    0x01, 0x02, 0x03, 0x04, 0x05, 0x06, 0x07, 0x08, 0x09, 0x0A, 0x01, 0x02, 0x03, 0x04, 0x05, 0x06, 0x07, 0x08, 0x09, 0x0A,
    0x01, 0x02, 0x03, 0x04, 0x05, 0x06, 0x07, 0x08, 0x09, 0x0A, 0x01, 0x02, 0x03, 0x04, 0x05, 0x06, 0x07, 0x08, 0x09, 0x0A,
    0x01, 0x02, 0x03, 0x04, 0x05, 0x06, 0x07, 0x08, 0x09, 0x0A, 0x01, 0x02, 0x03, 0x04, 0x05, 0x06, 0x07, 0x08, 0x09, 0x0A,
    0x01, 0x02, 0x03, 0x04, 0x05, 0x06, 0x07, 0x08, 0x09, 0x0A, 0x01, 0x02, 0x03, 0x04, 0x05, 0x06, 0x07, 0x08, 0x09, 0x0A,
    0x01, 0x02, 0x03, 0x04, 0x05, 0x06, 0x07, 0x08, 0x09, 0x0A, 0x01, 0x02, 0x03, 0x04, 0x05, 0x06, 0x07, 0x08, 0x09, 0x0A,
    0x01, 0x02, 0x03, 0x04, 0x05, 0x06, 0x07, 0x08, 0x09, 0x0A, 0x01, 0x02, 0x03, 0x04, 0x05, 0x06, 0x07, 0x08, 0x09, 0x0A,
    0x01, 0x02, 0x03, 0x04, 0x05, 0x06, 0x07, 0x08, 0x09, 0x0A, 0x01, 0x02, 0x03, 0x04, 0x05, 0x06, 0x07, 0x08, 0x09, 0x0A,
    0x01, 0x02, 0x03, 0x04, 0x05, 0x06, 0x07, 0x08, 0x09, 0x0A, 0x01, 0x02, 0x03, 0x04, 0x05, 0x06, 0x07, 0x08, 0x09, 0x0A,
    0x01, 0x02, 0x03, 0x04, 0x05, 0x06, 0x07, 0x08, 0x09, 0x0A, 0x01, 0x02, 0x03, 0x04, 0x05, 0x06, 0x07, 0x08, 0x09, 0x0A,
    0x01, 0x02, 0x03, 0x04, 0x05, 0x06, 0x07, 0x08, 0x09, 0x0A, 0x01, 0x02, 0x03, 0x04, 0x05, 0x06, 0x07, 0x08, 0x09, 0x0A,
    0x01, 0x02, 0x03, 0x04, 0x05, 0x06, 0x07, 0x08, 0x09, 0x0A, 0x01, 0x02, 0x03, 0x04, 0x05, 0x06, 0x07, 0x08, 0x09, 0x0A,
    0x01, 0x02, 0x03, 0x04, 0x05, 0x06, 0x07, 0x08, 0x09, 0x0A, 0x01, 0x02, 0x03, 0x04, 0x05, 0x06, 0x07, 0x08, 0x09, 0x0A,
    0x01, 0x02, 0x03, 0x04, 0x05, 0x06, 0x07, 0x08, 0x09, 0x0A, 0x01, 0x02, 0x03, 0x04, 0x05, 0x06, 0x07, 0x08, 0x09, 0x0A,
    0x01, 0x02, 0x03, 0x04, 0x05, 0x06, 0x07, 0x08, 0x09, 0x0A, 0x01, 0x02, 0x03, 0x04, 0x05, 0x06, 0x07, 0x08, 0x09, 0x0A,
    0x01, 0x02, 0x03, 0x04, 0x05, 0x06, 0x07, 0x08, 0x09, 0x0A, 0x01, 0x02, 0x03, 0x04, 0x05, 0x06, 0x07, 0x08, 0x09, 0x0A,
    0x01, 0x02, 0x03, 0x04, 0x05, 0x06, 0x07, 0x08, 0x09, 0x0A, 0x01, 0x02, 0x03, 0x04, 0x05, 0x06, 0x07, 0x08, 0x09, 0x0A,
    0x01, 0x02, 0x03, 0x04, 0x05, 0x06, 0x07, 0x08, 0x09, 0x0A, 0x01, 0x02, 0x03, 0x04, 0x05, 0x06, 0x07, 0x08, 0x09, 0x0A,
    0x01, 0x02, 0x03, 0x04, 0x05, 0x06, 0x07, 0x08, 0x09, 0x0A, 0x01, 0x02, 0x03, 0x04, 0x05, 0x06, 0x07, 0x08, 0x09, 0x0A,
    0x01, 0x02, 0x03, 0x04, 0x05, 0x06, 0x07, 0x08, 0x09, 0x0A, 0x01, 0x02, 0x03, 0x04, 0x05, 0x06, 0x07, 0x08, 0x09, 0x0A,
    0x01, 0x02, 0x03, 0x04, 0x05, 0x06, 0x07, 0x08, 0x09, 0x0A, 0x01, 0x02, 0x03, 0x04, 0x05, 0x06, 0x07, 0x08, 0x09, 0x0A,
    0x01, 0x02, 0x03, 0x04, 0x05, 0x06, 0x07, 0x08, 0x09, 0x0A, 0x01, 0x02, 0x03, 0x04, 0x05, 0x06, 0x07, 0x08, 0x09, 0x0A,
    0x01, 0x02, 0x03, 0x04, 0x05, 0x06, 0x07, 0x08, 0x09, 0x0A, 0x01, 0x02, 0x03, 0x04, 0x05, 0x06, 0x07, 0x08, 0x09, 0x0A,
    0x01, 0x02, 0x03, 0x04, 0x05, 0x06, 0x07, 0x08, 0x09, 0x0A, 0x01, 0x02, 0x03, 0x04, 0x05, 0x06, 0x07, 0x08, 0x09, 0x0A
};

const size_t test_large_data_obj_len = ARR_SIZE(test_large_data_obj);
```

## src/test_data_common.h
```c
/*
 * Copyright (c) 2020 Infineon Technologies AG
 *
 * SPDX-License-Identifier: Apache-2.0
 */

#ifndef _H_TEST_DATA_COMMON_H_
#define _H_TEST_DATA_COMMON_H_

#include <stdint.h>
#include <stddef.h>

/*
// Signature signing key
uint8_t sign_key2[] = {
    0x21, 0xFB, 0x35, 0x5D, 0x5B, 0xAB, 0xB0, 0x45, 0xEB, 0x34, 0xF6, 0x66, 0xF6, 0xA9, 0x3D, 0xD2,
    0x75, 0x14, 0xE0, 0xA1, 0x27, 0xD9, 0xD0, 0x1A, 0x79, 0x4C, 0xC8, 0x1A, 0xE6, 0x47, 0x86, 0x1A
}; */

// Signature verification key
extern const uint8_t verify_test_key[];
extern const size_t verify_test_key_len;

// Signature verification key OPTIGA hack, prefixed with 0x04
extern const uint8_t verify_test_key_optiga[];
extern const size_t verify_test_key_optiga_len;

extern const uint8_t test_hash[];
extern const size_t test_hash_len;

extern const uint8_t test_signature[];
extern const size_t test_signature_len;

extern const uint8_t test_signature_der[];
extern const size_t test_signature_der_len;

extern const uint8_t test_signature_hash[];
extern const size_t test_signature_hash_len;

extern const uint8_t test_certificate[];

extern const uint8_t test_large_data_obj[];
extern const size_t test_large_data_obj_len;

extern const uint8_t test_small_data_obj[];
extern const size_t test_small_data_obj_len;

#endif // _H_TEST_DATA_COMMON_H_
```

## src/test_optiga_apdu.c
```c
/*
 * Copyright (c) 2020 Infineon Technologies AG
 *
 * SPDX-License-Identifier: Apache-2.0
 */

#include <ztest.h>
#include <zephyr.h>
#include <sys/byteorder.h>

#include <drivers/crypto/optiga_apdu.h>

static struct device *dev = NULL;

static const uint8_t get_data_object_apdu[] = {
	0x81,           /* command code */
	0x00,           /* param, read data */
	0x00, 0x02,     /* Length */
	0xE0, 0xC2,     /* OID of Coprocessor UID */
};

static void test_find_chip(void)
{
	dev = device_get_binding("trust-m");
	zassert_not_null(dev, "Device not found");
}

static void test_get_chip_id(void)
{
#define TMP_BUF_SIZE 1024
	uint8_t tmp_buf[TMP_BUF_SIZE] = { 0 };
	/* Non-unique data from Coprocessor UID, see "Table 38 - Coprocessor UID OPTIGA™ Trust Family" for details */
	static const uint8_t expected_id[] = {
		0xCD,                                   /* CIM Identifier */
		0x16,                                   /* Platform Identifier */
		0x33,                                   /* Model Identifier */
		0x82, 0x01,                             /* ID of ROM mask */
		0x00, 0x1C, 0x00, 0x05, 0x00, 0x00,     /* Chip type */
	};

	struct optiga_apdu get_do_txrx = {
		.tx_buf = get_data_object_apdu,
		.tx_len = sizeof(get_data_object_apdu),
		.rx_buf = tmp_buf,
		.rx_len = TMP_BUF_SIZE,
	};

	optiga_enqueue_apdu(dev, &get_do_txrx);

	struct k_poll_event events[1] = {
		K_POLL_EVENT_INITIALIZER(K_POLL_TYPE_SIGNAL,
					 K_POLL_MODE_NOTIFY_ONLY,
					 &get_do_txrx.finished),
	};

	k_poll(events, 1, K_FOREVER);

	int res = events[0].signal->result;

	zassert_equal(res, OPTIGA_STATUS_CODE_SUCCESS, "Event returned error code");
	zassert_equal(get_do_txrx.rx_buf[0], 0x00, "APDU error status code");
	zassert_equal(get_do_txrx.rx_len, 31, "returned data has unexpected length");
	const uint16_t len = sys_get_be16(&get_do_txrx.rx_buf[2]);
	zassert_equal(len, 27, "APDU encodes wrong length");
	const uint8_t *apdu_data = get_do_txrx.rx_buf + 4;

	/* Can only compare the non-unique part here */
	zassert_mem_equal(apdu_data, expected_id, sizeof(expected_id), "Unexpected chip");

#undef TMP_BUF_SIZE
}

static void test_invalid_apdu(void)
{
#define TMP_BUF_SIZE 100
	uint8_t tmp_buf[TMP_BUF_SIZE] = { 0 };
	/* Invalid Command, minimum APDU length is 4 */
	static const uint8_t invalid_apdu[] = { 0x00, 0x00, 0x00, 0x00 };

	struct optiga_apdu get_do_txrx = {
		.tx_buf = invalid_apdu,
		.tx_len = sizeof(invalid_apdu),
		.rx_buf = tmp_buf,
		.rx_len = TMP_BUF_SIZE,
	};

	optiga_enqueue_apdu(dev, &get_do_txrx);

	struct k_poll_event events[1] = {
		K_POLL_EVENT_INITIALIZER(K_POLL_TYPE_SIGNAL,
					 K_POLL_MODE_NOTIFY_ONLY,
					 &get_do_txrx.finished),
	};

	k_poll(events, 1, K_FOREVER);

	int res = events[0].signal->result;

	zassert_equal(res != OPTIGA_STATUS_CODE_SUCCESS, 1, "This command doesn't exist and should fail");
#undef TMP_BUF_SIZE
}

void test_session_context(void)
{
	int token = 0;
	bool res = optiga_session_acquire(dev, token);

	zassert_equal(res, true, "Couldn't acquire session token");

	res = optiga_session_acquire(dev, token);
	zassert_equal(res, false, "Acquired same token twice");

	optiga_session_release(dev, token);
}

void test_error_code(void)
{
	bool res = optiga_is_device_error(OPTIGA_STATUS_CODE_SUCCESS);

	zassert_equal(res, false, "Success reported as device error");

	res = optiga_is_driver_error(OPTIGA_STATUS_CODE_SUCCESS);
	zassert_equal(res, false, "Success reported as driver error");
}

void test_optiga_apdu_main(void)
{
	ztest_test_suite(optiga_driver_tests,
			 ztest_unit_test(test_find_chip),
			 ztest_unit_test(test_get_chip_id),
			 ztest_unit_test(test_session_context),
			 ztest_unit_test(test_invalid_apdu),
			 ztest_unit_test(test_error_code)
			 );

	ztest_run_test_suite(optiga_driver_tests);
}
```

## src/test_optiga_trust_m.c
```c
/*
 * Copyright (c) 2020 Infineon Technologies AG
 *
 * SPDX-License-Identifier: Apache-2.0
 */

#include <ztest.h>
#include <zephyr.h>

#include <drivers/crypto/optiga_trust_m.h>
#include "test_data_common.h"

static struct device *dev = NULL;
static struct optrust_ctx ctx;
static uint8_t apdu_buf[OPTRUST_CERT_READ_APDU_SIZE] = { 0 };

#define PUB_KEY_CERT_OID OPTRUST_OID_PUB_KEY_CERT_2

void test_init_trust_m(void)
{
	dev = device_get_binding("trust-m");
	zassert_not_null(dev, "Device not found");
	int res = optrust_init(&ctx, dev, apdu_buf, OPTRUST_CERT_READ_APDU_SIZE);

	zassert_equal(res, 0, "Expected success return code");
}

void test_get_uid(void)
{
	/* Non-unique data from Coprocessor UID, see "Table 38 - Coprocessor UID OPTIGA™ Trust Family" for details */
	static const uint8_t expected_id[] = {
		0xCD,                                   /* CIM Identifier */
		0x16,                                   /* Platform Identifier */
		0x33,                                   /* Model Identifier */
		0x82, 0x01,                             /* ID of ROM mask */
		0x00, 0x1C, 0x00, 0x05, 0x00, 0x00,     /* Chip type */
	};

#define TMP_BUF_SIZE 100
	uint8_t tmp_buf[TMP_BUF_SIZE] = { 0 };
	size_t tmp_buf_len = TMP_BUF_SIZE;

	int res = optrust_data_get(&ctx, OPTRUST_OID_COPROCESSOR_UID, 0, tmp_buf, &tmp_buf_len);
	zassert_equal(res, 0, "Expected success return code");

	/* Can only compare the non-unique part here */
	zassert_mem_equal(tmp_buf, expected_id, sizeof(expected_id), "Unexpected chip");
#undef TMP_BUF_SIZE
}

void test_data_object_large(void)
{
	uint8_t tmp_buf[OPTRUST_DATA_OBJECT_TYPE2_LEN] = { 0 };
	size_t tmp_buf_len = OPTRUST_DATA_OBJECT_TYPE2_LEN;

	/* Fill a data object with test data */
	int res = optrust_data_set(&ctx, OPTRUST_OID_DATA_OBJECT_17, true, 0, test_large_data_obj, test_large_data_obj_len);

	zassert_equal(res, 0, "Writing test data failed");

	/* Read back test data */
	res = optrust_data_get(&ctx, OPTRUST_OID_DATA_OBJECT_17, 0, tmp_buf, &tmp_buf_len);
	zassert_equal(res, 0, "Reading test data failed");
	zassert_equal(tmp_buf_len, test_large_data_obj_len, "Read back size is different");
	zassert_mem_equal(tmp_buf, test_large_data_obj, tmp_buf_len, "Data doesn't match");
}

void test_data_object_small(void)
{
	uint8_t tmp_buf[OPTRUST_DATA_OBJECT_TYPE3_LEN] = { 0 };
	size_t tmp_buf_len = OPTRUST_DATA_OBJECT_TYPE3_LEN;

	/* Fill a data object with test data */
	int res = optrust_data_set(&ctx, OPTRUST_OID_DATA_OBJECT_1, true, 0, test_small_data_obj, test_small_data_obj_len);

	zassert_equal(res, 0, "Writing test data failed");

	/* Read back test data */
	res = optrust_data_get(&ctx, OPTRUST_OID_DATA_OBJECT_1, 0, tmp_buf, &tmp_buf_len);
	zassert_equal(res, 0, "Reading test data failed");
	zassert_equal(tmp_buf_len, test_small_data_obj_len, "Read back size is different");
	zassert_mem_equal(tmp_buf, test_small_data_obj, tmp_buf_len, "Data doesn't match");
}

/* This test is just a helper to get the stripped certificate into a data object */
void test_extract_cert(void)
{
	uint8_t cert_buf[OPTRUST_PUB_KEY_CERT_LEN] = { 0 };
	size_t cert_buf_len = OPTRUST_PUB_KEY_CERT_LEN;

	/* read device certificate */
	int res = optrust_data_get(&ctx, OPTRUST_OID_PUB_KEY_CERT_1, 0, cert_buf, &cert_buf_len);

	zassert_equal(res, 0, "Reading certificate failed");

	/* Write the stripped device certificate to another data object */
	res = optrust_data_set(&ctx, PUB_KEY_CERT_OID, true, 0, cert_buf + 9, cert_buf_len - 9);
	zassert_equal(res, 0, "Writing stripped certificate failed");
}

static const uint8_t test_digest[OPTRUST_SHA256_DIGEST_LEN] = {
	0x00, 0x01, 0x02, 0x03, 0x04, 0x05, 0x06, 0x07, 0x08, 0x09, 0x0A, 0x0B, 0x0C, 0x0D, 0x0E, 0x0F, /* 16 bytes data */
	0x00, 0x01, 0x02, 0x03, 0x04, 0x05, 0x06, 0x07, 0x08, 0x09, 0x0A, 0x0B, 0x0C, 0x0D, 0x0E, 0x0F, /* 16 bytes data */
};

void test_sign_verify_good(void)
{
	uint8_t sig[OPTRUST_NIST_P256_SIGNATURE_LEN] = { 0 };
	size_t sig_len = OPTRUST_NIST_P256_SIGNATURE_LEN;

	/* Use the device key to create a signature */
	int res = optrust_ecdsa_sign_oid(&ctx, OPTRUST_OID_ECC_KEY_1, test_digest, OPTRUST_SHA256_DIGEST_LEN,
					 sig, &sig_len);

	zassert_equal(res, 0, "Sign OID command failed");
	zassert_equal(sig_len, OPTRUST_NIST_P256_SIGNATURE_LEN, "Signature length changed to unexpected value");


	/* Verify the signature using the stripped certificate */
	res = optrust_ecdsa_verify_oid(&ctx, PUB_KEY_CERT_OID, test_digest, OPTRUST_SHA256_DIGEST_LEN,
				       sig, OPTRUST_NIST_P256_SIGNATURE_LEN);

	zassert_equal(res, 0, "Verify OID command failed");
}

void test_sign_verify_bad_hash(void)
{
	uint8_t sig[OPTRUST_NIST_P256_SIGNATURE_LEN] = { 0 };
	size_t sig_len = OPTRUST_NIST_P256_SIGNATURE_LEN;

	uint8_t diff_digest[OPTRUST_SHA256_DIGEST_LEN] = { 0 };

	/* Use the device key to create a signature */
	int res = optrust_ecdsa_sign_oid(&ctx, OPTRUST_OID_ECC_KEY_1, test_digest, OPTRUST_SHA256_DIGEST_LEN,
					 sig, &sig_len);

	zassert_equal(res, 0, "Sign OID command failed");
	zassert_equal(sig_len, OPTRUST_NIST_P256_SIGNATURE_LEN, "Signature length changed to unexpected value");

	memcpy(diff_digest, test_digest, OPTRUST_SHA256_DIGEST_LEN);

	/* Flip a bit in the hash to trigger a verification fail */
	diff_digest[7] ^= 1 << 5;

	/* Verify the signature using the wrong hash */
	res = optrust_ecdsa_verify_oid(&ctx, PUB_KEY_CERT_OID, diff_digest, OPTRUST_SHA256_DIGEST_LEN,
				       sig, OPTRUST_NIST_P256_SIGNATURE_LEN);

	/* Signature check must not pass */
	zassert_false(res == 0, "Verification with wrong hash passed");
}

void test_sign_verify_bad_sig(void)
{
	uint8_t sig[OPTRUST_NIST_P256_SIGNATURE_LEN] = { 0 };
	size_t sig_len = OPTRUST_NIST_P256_SIGNATURE_LEN;

	/* Use the device key to create a signature */
	int res = optrust_ecdsa_sign_oid(&ctx, OPTRUST_OID_ECC_KEY_1, test_digest, OPTRUST_SHA256_DIGEST_LEN,
					 sig, &sig_len);

	zassert_equal(res, 0, "Sign OID command failed");
	zassert_equal(sig_len, OPTRUST_NIST_P256_SIGNATURE_LEN, "Signature length changed to unexpected value");

	/* Flip a bit in the signature to trigger a verification fail */
	sig[7] ^= 1 << 5;

	/* Verify the signature using the wrong signature */
	res = optrust_ecdsa_verify_oid(&ctx, PUB_KEY_CERT_OID, test_digest, OPTRUST_SHA256_DIGEST_LEN,
				       sig, OPTRUST_NIST_P256_SIGNATURE_LEN);

	/* Signature check must not pass */
	zassert_false(res == 0, "Verification with wrong hash passed");
}

/* SHA256 digest of test_small_data_obj */
static const uint8_t digest_ref[OPTRUST_SHA256_DIGEST_LEN] = {
	0xAF, 0xE4, 0xE1, 0x65, 0x92, 0xD0, 0xF7, 0x95,
	0xAC, 0x83, 0x31, 0x31, 0xE4, 0x00, 0x13, 0x49,
	0x1A, 0x72, 0x5A, 0xDB, 0x4D, 0x46, 0xB2, 0x59,
	0xB6, 0x5B, 0x5B, 0xFC, 0x90, 0xF6, 0xA1, 0xF8,
};

void test_sha256_ext(void)
{
	uint8_t digest_ext[OPTRUST_SHA256_DIGEST_LEN] = { 0 };

	size_t digest_len = OPTRUST_SHA256_DIGEST_LEN;
	int res = optrust_sha256_ext(&ctx, test_small_data_obj, test_small_data_obj_len, digest_ext, &digest_len);

	zassert_equal(res, 0, "Hash OID command failed");
	zassert_equal(digest_len, OPTRUST_SHA256_DIGEST_LEN, "Digest length changed to unexpected value");
	zassert_mem_equal(digest_ext, digest_ref, OPTRUST_SHA256_DIGEST_LEN, "Different digest computed");
}

void test_sha256_oid(void)
{
	uint8_t digest_oid[OPTRUST_SHA256_DIGEST_LEN] = { 0 };

	size_t digest_len = OPTRUST_SHA256_DIGEST_LEN;
	int res = optrust_sha256_oid(&ctx, OPTRUST_OID_DATA_OBJECT_1, 0,
				     test_small_data_obj_len, digest_oid, &digest_len);

	zassert_equal(res, 0, "Hash OID command failed");
	zassert_equal(digest_len, OPTRUST_SHA256_DIGEST_LEN, "Digest length changed to unexpected value");
	zassert_mem_equal(digest_oid, digest_ref, OPTRUST_SHA256_DIGEST_LEN, "Different digests computed");
}

void test_ecdh_calc(void)
{
	uint8_t pub_key1[OPTRUST_NIST_P256_PUB_KEY_LEN] = { 0 };
	size_t pub_key1_len = OPTRUST_NIST_P256_PUB_KEY_LEN;
	uint16_t sec_key1_oid = OPTRUST_OID_ECC_KEY_2;

	int res = optrust_ecc_gen_keys_oid(&ctx, sec_key1_oid, OPTRUST_ALGORITHM_NIST_P256,
					   OPTRUST_KEY_USAGE_FLAG_KEY_AGREE, pub_key1, &pub_key1_len);

	zassert_equal(res, 0, "Key pair 1 generation failed");

	uint8_t pub_key2[OPTRUST_NIST_P256_PUB_KEY_LEN] = { 0 };
	size_t pub_key2_len = OPTRUST_NIST_P256_PUB_KEY_LEN;
	uint16_t sec_key2_oid = OPTRUST_OID_ECC_KEY_3;

	res = optrust_ecc_gen_keys_oid(&ctx, sec_key2_oid, OPTRUST_ALGORITHM_NIST_P256,
				       OPTRUST_KEY_USAGE_FLAG_KEY_AGREE, pub_key2, &pub_key2_len);

	zassert_equal(res, 0, "Key pair 2 generation failed");

	uint8_t shared_secret1_ext[OPTRUST_ECDH_SHARED_SECRET_NIST_P256_LEN] = { 0 };
	size_t shared_secret1_ext_len = OPTRUST_ECDH_SHARED_SECRET_NIST_P256_LEN;

	res = optrust_ecdh_calc_ext(&ctx, sec_key1_oid, OPTRUST_ALGORITHM_NIST_P256,
				    pub_key2, pub_key2_len, shared_secret1_ext, &shared_secret1_ext_len);
	zassert_equal(res, 0, "Calculating shared secret 1 failed");

	uint8_t shared_secret2_ext[OPTRUST_ECDH_SHARED_SECRET_NIST_P256_LEN] = { 0 };
	size_t shared_secret2_ext_len = OPTRUST_ECDH_SHARED_SECRET_NIST_P256_LEN;

	res = optrust_ecdh_calc_ext(&ctx, sec_key2_oid, OPTRUST_ALGORITHM_NIST_P256,
				    pub_key1, pub_key1_len, shared_secret2_ext, &shared_secret2_ext_len);
	zassert_equal(res, 0, "Calculating shared secret 2 failed");
	zassert_equal(shared_secret1_ext_len, shared_secret2_ext_len, "Shared secrets should have same length");
	zassert_mem_equal(shared_secret1_ext, shared_secret2_ext, shared_secret1_ext_len, "Shared secrets must match");

	uint16_t shared_secret1_oid = 0;

	res = optrust_session_acquire(&ctx, &shared_secret1_oid);

	zassert_equal(res, 0, "Reserving session context failed");

	res = optrust_ecdh_calc_oid(&ctx, sec_key1_oid, OPTRUST_ALGORITHM_NIST_P256, pub_key2, pub_key2_len, shared_secret1_oid);
	zassert_equal(res, 0, "Calculating shared secret and storing in OID failed");

	res = optrust_session_release(&ctx, shared_secret1_oid);
	zassert_equal(res, 0, "Releasing session context failed");
}


void test_optiga_trust_m_main(void)
{
	ztest_test_suite(optiga_trust_m_tests,
			 ztest_unit_test(test_init_trust_m),
			 ztest_unit_test(test_get_uid),
			 ztest_unit_test(test_data_object_small),
			 ztest_unit_test(test_data_object_large),
			 ztest_unit_test(test_extract_cert),
			 ztest_unit_test(test_sign_verify_good),
			 ztest_unit_test(test_sign_verify_bad_hash),
			 ztest_unit_test(test_sign_verify_bad_sig),
			 ztest_unit_test(test_sha256_ext),
			 ztest_unit_test(test_sha256_oid),
			 ztest_unit_test(test_ecdh_calc)
			 );

	ztest_run_test_suite(optiga_trust_m_tests);
}
```
