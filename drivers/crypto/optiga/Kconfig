## drivers/crypto/optiga/Kconfig
```kconfig
# Kconfig - OPTIGA stack configuration options

#
# Copyright (c) 2019 Infineon Technologies AG
#
# SPDX-License-Identifier: Apache-2.0
#

menuconfig OPTIGA
	bool "OPTIGA security controller"
	depends on I2C && HAS_DTS_I2C && GPIO
	help
	  Enable driver for OPTIGA security controller.

if OPTIGA

config OPTIGA_HOST_BUFFER_SIZE
    int "Buffer size for communication with OPTIGA"
	range 17 655356
    default 278
	help
		This value should be set as MAX_PACKET_SIZE + 6 from the solution
		reference manual.
	  
		It can be set lower to trade performance for RAM.

config OPTIGA_THREAD_PRIORITY
	int "Priority of the driver thread"
	default 1

endif # OPTIGA
```

## dts/bindings/crypto/infineon,optiga-trust-m.yaml
```yaml
# Copyright (c) 2019 - 2020, Infineon Technologies AG
# SPDX-License-Identifier: Apache-2.0

description: >
    This is a representation of the OPTIGA Trust M security controller

compatible: "infineon,optiga-trust-m"

include: i2c-device.yaml

properties:
    power-gpios:
      type: phandle-array
      required: false
      description: |
        Power control for the OPTIGA Trust M. Logic '1' means power on.
```

## dts/bindings/crypto/infineon,optiga-trust-x.yaml
```yaml
# Copyright (c) 2019 - 2020, Infineon Technologies AG
# SPDX-License-Identifier: Apache-2.0

description: >
    This is a representation of the OPTIGA Trust X security controller

compatible: "infineon,optiga-trust-x"

include: i2c-device.yaml

#properties:
#    reset-gpios:
#      type: phandle-array
#      required: true
```

## tests/drivers/optiga/testcase.yaml
```yaml
tests:
  # section.subsection
  testing.ztest:
    build_only: true
    tags: testing
  
```
